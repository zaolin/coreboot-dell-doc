## data/src/mainboard/dell_inc/vostro_3460/Kconfig
```kconfig
if BOARD_DELL_INC_VOSTRO_3460

config BOARD_SPECIFIC_OPTIONS # dummy
	def_bool y
	select ARCH_X86
	select BOARD_ROMSIZE_KB_2048
	select CPU_INTEL_SOCKET_RPGA989
	select HAVE_ACPI_RESUME
	select HAVE_ACPI_TABLES
	select INTEL_EDID
	select INTEL_INT15
	select IVYBRIDGE_LVDS
	select MAINBOARD_HAS_NATIVE_VGA_INIT
	select MAINBOARD_HAS_NATIVE_VGA_INIT_TEXTMODECFG
	select NORTHBRIDGE_INTEL_IVYBRIDGE_NATIVE
	select VGA

config HAVE_IFD_BIN
	string
	default n

config HAVE_ME_BIN
	string
	default n

config MAINBOARD_DIR
	string
	default dell_inc/vostro_3460

config MAINBOARD_PART_NUMBER
	string
	default "Vostro 3460"

config VGA_BIOS_FILE
	string
	default "pci8086,0166.rom"

config VGA_BIOS_ID
	string
	default "8086,0166"

config MMCONF_BASE_ADDRESS
	hex
	default 0xf0000000

config MAX_CPUS
	int
	default 8
endif
```
